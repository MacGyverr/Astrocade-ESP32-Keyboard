## sdkconfig.defaults.esp32s3
```kconfig
# ESP32-S3-WROOM-1-N8R2: 8 MB flash, 2 MB Quad PSRAM.
CONFIG_ESPTOOLPY_FLASHSIZE_8MB=y
CONFIG_ESPTOOLPY_FLASHSIZE="8MB"
CONFIG_SPIRAM=y
CONFIG_SPIRAM_MODE_QUAD=y
CONFIG_SPIRAM_TYPE_AUTO=y
CONFIG_SPIRAM_SPEED_80M=y
CONFIG_SPIRAM_USE_CAPS_ALLOC=y
CONFIG_SPIRAM_MEMTEST=y
CONFIG_ESP_CONSOLE_SECONDARY_NONE=y
# CONFIG_ESP_CONSOLE_SECONDARY_USB_SERIAL_JTAG is not set
# CONFIG_ESP_CONSOLE_USB_SERIAL_JTAG_ENABLED is not set
# CONFIG_USJ_ENABLE_USB_SERIAL_JTAG is not set
CONFIG_PARTITION_TABLE_CUSTOM_FILENAME="partitions_8mb.csv"
```
